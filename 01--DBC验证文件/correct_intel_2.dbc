VERSION ""

NS_ :

BS_:

BU_:

BO_ 100 EngineData: 8 Vector__XXX
 SG_ EngineSpeed : 0|16@1+ (0.1,0) [0|8000] "rpm" Vector__XXX
 SG_ EngineTemp : 16|8@1+ (1,-40) [-40|215] "degC" Vector__XXX

BO_ 200 VehicleData: 8 Vector__XXX
 SG_ VehicleSpeed : 0|16@1+ (0.01,0) [0|300] "km/h" Vector__XXX
 SG_ FuelLevel : 16|8@1+ (0.5,0) [0|100] "%" Vector__XXX

BA_DEF_ BO_  "BusType" STRING ;
BA_DEF_ BO_  "Variant" STRING ;
BA_ "BusType" BO_ 100 "CAN";
BA_ "Variant" BO_ 100 "HighSpeed";
