VERSION ""

NS_ :

BS_:

BU_:

BO_ 100 MotorolaTest: 8 Vector__XXX
 SG_ TestSignal : 11|12@1- (0.1,0) [0|4095] "test" Vector__XXX
